## firmware/brookesia/components/Toolbox/Kconfig.projbuild
```kconfig
menu "Wi-Fi Toolbox"

    config TOOLBOX_ALLOW_INJECTION
        bool "Offer frame injection in the app"
        default y
        help
            With this off, InjectStart is refused on the host so the build cannot
            ask the co-processor to transmit. On its own that would be a false
            sense of safety — the injecting code lives in the co-processor's
            firmware — so a shipped image must also be built with the
            co-processor's WIFI_TOOLBOX_ALLOW_INJECTION off. That flag lives with
            the co-processor component (components/wifi_toolbox/Kconfig).

            Capture and the net utilities are unaffected.

endmenu

menu "BLE Toolbox"

    config BLE_TOOLBOX_ALLOW_SPAM
        bool "Compile the BLE Toolbox's advertisement transmit path"
        default y
        help
            Builds the BLE Spam screen and the code behind it. The gate is
            enforced in this firmware: an explicit acknowledgement, a duration
            capped and re-checked on every tick, non-connectable and
            non-scannable frames, and an indicator for as long as it transmits.

            Off removes the code rather than hiding the button.

endmenu

    config TOOLBOX_SCREENSHOT_SERVER
        bool "Serve the screen over HTTP for diagnostics"
        default n
        help
            Starts a small HTTP server on the board's Wi-Fi address that serves
            the current framebuffer as a BMP. A bench aid for a development
            build: it exposes the screen to anyone on the network with no
            authentication, so it is OFF by default.
```

## firmware/brookesia/components/wifi_toolbox/Kconfig
```kconfig
menu "Wi-Fi Toolbox (co-processor)"

    config WIFI_TOOLBOX_ALLOW_INJECTION
        bool "Build raw-frame injection into the co-processor image"
        default y
        help
            Spec section 10.5: the shipped co-processor image must be buildable
            without frame injection, so that a product that does not offer the
            tool cannot be made to transmit raw frames at all.

            The flag has to exist on the co-processor and not only on the host:
            the injecting code lives here, and a host-side flag would be a false
            sense of safety. With this off, the injection engine, its frame
            builders and its RPC handlers are compiled out, the capability report
            says injection_available = 0, and INJECT_START answers
            WIFI_TOOLBOX_ERR_UNSUPPORTED instead of transmitting.

            Capture and the net utilities are unaffected.

    config WIFI_TOOLBOX_CMD_HANDLERS
        int "Size of the toolbox custom-RPC callback table"
        range 8 32
        default 12
        help
            How many command message IDs the toolbox may register on esp-hosted's
            peer-data channel. That table is fixed-size, and a registration past
            the end fails **at runtime** with nothing but a log line on the
            co-processor's console — which is not wired to the host. From the host
            the symptom is a command that never answers, indistinguishable from a
            dropped link.

            This is the size the toolbox asks for; wifi_toolbox_rpc.c asserts at
            compile time that it registers no more than this, so adding a message
            ID without room for it stops the build instead of silently dropping a
            command at runtime.

endmenu
```
