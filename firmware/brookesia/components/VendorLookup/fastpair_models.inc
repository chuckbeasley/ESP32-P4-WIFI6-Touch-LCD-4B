/*
 * Google Fast Pair 24-bit model IDs, transcribed from Fieldwatch's FastPairModels.kt
 * (public partner/community listings). The lookup is a linear scan over ~110 entries, so
 * no sort order is required.
 */
typedef struct { uint32_t id; const char *name; } fastpair_model_t;

static const fastpair_model_t fastpair_models[] = {
    { 0x000006, "Google Pixel Buds" },
    { 0x000007, "Android Auto" },
    { 0x00000B, "Google Gphones" },
    { 0x00000C, "Google Set Up Device" },
    { 0x00000F, "Google Pixel Buds A-Series" },
    { 0x000035, "Fast Pair test device" },
    { 0x000047, "Arduino 101" },
    { 0x000048, "Fast Pair Headphones" },
    { 0x000049, "Fast Pair Headphones" },
    { 0x0000F0, "Bose QuietComfort 35 II" },
    { 0x0001F0, "Bisto CSR8670" },
    { 0x0002F0, "JBL Everest 110GA" },
    { 0x0003F0, "LG HBS-835S" },
    { 0x001000, "LG HBS1110" },
    { 0x002000, "AIAIAI TMA-2" },
    { 0x003000, "Libratone Q Adapt On-Ear" },
    { 0x003001, "Libratone Q Adapt On-Ear" },
    { 0x003B41, "M&D MW65" },
    { 0x003D8A, "Cleer FLOW II" },
    { 0x005BC3, "Panasonic RP-HD610N" },
    { 0x008F7D, "soundcore Glow Mini" },
    { 0x00A168, "boAt Airdopes 621" },
    { 0x00AA48, "Jabra Elite 2" },
    { 0x00AA91, "Beoplay E8 2.0" },
    { 0x00C95C, "Sony WF-1000X" },
    { 0x00FA72, "Pioneer SE-MS9BN" },
    { 0x0100F0, "Bose QuietComfort 35 II" },
    { 0x011242, "Nirvana Ion" },
    { 0x013D8A, "Cleer EDGE Voice" },
    { 0x01AA91, "Beoplay H9 3rd gen" },
    { 0x01C95C, "Sony WF-1000X" },
    { 0x01EEB4, "Sony WH-1000XM4" },
    { 0x02AA91, "B&O Earset" },
    { 0x02C95C, "Sony WH-1000XM2" },
    { 0x02D815, "Audio-Technica ATH-CK1TW" },
    { 0x02D886, "JBL Reflect Mini NC" },
    { 0x02DD4F, "JBL Tune 770NC" },
    { 0x02E2A9, "TCL MOVEAUDIO S200" },
    { 0x02F637, "JBL Live Flex" },
    { 0x035754, "Plantronics PLT K2" },
    { 0x035764, "Plantronics V8200" },
    { 0x038B91, "DENON AH-C830NCW" },
    { 0x038CC7, "JBL Tune 760NC" },
    { 0x038F16, "Beats Studio Buds" },
    { 0x03AA91, "B&O Beoplay H8i" },
    { 0x03C95C, "Sony WH-1000XM2" },
    { 0x03C99C, "Moto Buds 135" },
    { 0x045754, "Plantronics PLT K2" },
    { 0x04AA91, "Beoplay H4" },
    { 0x04ACFC, "JBL Wave Beam" },
    { 0x04AFB8, "JBL Tune 720BT" },
    { 0x04C95C, "Sony WI-1000X" },
    { 0x050F0C, "Marshall Major III Voice" },
    { 0x052CC7, "Marshall Minor III" },
    { 0x054B2D, "JBL Tune 125TWS" },
    { 0x0577B1, "Galaxy S23 Ultra" },
    { 0x057802, "TicWatch Pro 5" },
    { 0x0582FD, "Google Pixel Buds" },
    { 0x058D08, "Sony WH-1000XM4" },
    { 0x05A963, "Wonderboom 3" },
    { 0x05A9BC, "Galaxy S20+" },
    { 0x05AA91, "B&O Beoplay E6" },
    { 0x05C452, "JBL Live 220BT" },
    { 0x05C95C, "Sony WI-1000X" },
    { 0x060000, "Google Pixel Buds" },
    { 0x0660D7, "JBL Live 770NC" },
    { 0x06AE20, "Galaxy S21 5G" },
    { 0x06C197, "OPPO Enco Air3 Pro" },
    { 0x06C95C, "Sony WH-1000XM2" },
    { 0x06D8FC, "soundcore Liberty 4 NC" },
    { 0x0744B6, "Technics EAH-AZ60M2" },
    { 0x07A41C, "Sony WF-C700N" },
    { 0x07C95C, "Sony WH-1000XM2" },
    { 0x07F426, "Nest Hub Max" },
    { 0x0E30C3, "Razer Hammerhead TWS" },
    { 0x2D7A23, "Sony WF-1000XM4" },
    { 0x30018E, "Google Pixel Buds Pro 2" },
    { 0x718FA4, "JBL Live 300TWS" },
    { 0x72EF8D, "Razer Hammerhead TWS X" },
    { 0x72FB00, "soundcore Spirit Pro" },
    { 0x821F66, "JBL Flip 6" },
    { 0x92BBBD, "Google Pixel Buds" },
    { 0x9D3F8A, "soundcore Liberty 4" },
    { 0xAE3989, "Xiaomi Redmi Buds 5 Pro" },
    { 0xCD8256, "Bose Noise Cancelling 700" },
    { 0xD0A72C, "Nothing Ear (a)" },
    { 0xD446A7, "Sony WH-1000XM5" },
    { 0xD446F9, "Jabra Elite 8 Active" },
    { 0xD5BC6B, "Sony WH-1000XM6" },
    { 0xD97EBA, "OnePlus Nord Buds 3 Pro" },
    { 0xF00000, "Bose QuietComfort 35 II" },
    { 0xF00002, "Bose QuietComfort Earbuds II" },
    { 0xF00200, "JBL Everest 110GA" },
    { 0xF00203, "JBL Everest 310GA" },
    { 0xF00207, "JBL Everest 710GA" },
    { 0xF00209, "JBL Live 400BT" },
    { 0xF0020E, "JBL Live 500BT" },
    { 0xF00213, "JBL Live 650BTNC" },
    { 0xF00300, "LG HBS-835S" },
    { 0xF00301, "LG HBS-835" },
    { 0xF00302, "LG HBS-830" },
    { 0xF00303, "LG HBS-930" },
    { 0xF00304, "LG HBS-1010" },
    { 0xF00305, "LG HBS-1500" },
    { 0xF00306, "LG HBS-1700" },
    { 0xF00307, "LG HBS-1120" },
    { 0xF00308, "LG HBS-1125" },
    { 0xF00309, "LG HBS-2000" },
    { 0xF0B77F, "soundcore Liberty 4 NC" },
    { 0xF52494, "JBL Buds Pro" },
};

static const uint32_t fastpair_model_count =
    (uint32_t)(sizeof(fastpair_models) / sizeof(fastpair_models[0]));
